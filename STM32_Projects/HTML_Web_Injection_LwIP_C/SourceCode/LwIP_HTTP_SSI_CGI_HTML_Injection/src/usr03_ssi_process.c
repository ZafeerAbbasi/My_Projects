/*
# ##############################################################################
# File: ur                                                                     #
# Project: src                                                                 #
# Created Date: Thursday, October 12th 2023, 2:37:20 am                        #
# Author: Zafeer Abbasi                                                        #
# ----------------------------------------------                               #
# Last Modified: Sunday, October 15th 2023, 1:24:02 pm                         #
# Modified By: Zafeer Abbasi                                                   #
# ----------------------------------------------                               #
# Copyright (c) 2023 Zafeer.A                                                  #
# ----------------------------------------------                               #
# HISTORY:                                                                     #
 */

/*##############################################################################################################################################*/
/*INCLUDES______________________________________________________________________________________________________________________________________*/
/*##############################################################################################################################################*/

#include "usr03_ssi_process.h"
#include "lwip/apps/httpd.h"
#include <string.h>
#include "main.h"
#include "usr04_button.h"
#include "usr02_adc.h"
#include "usr00_led.h"
#include <stdbool.h>
#include "usr05_cgi_process.h"

/*##############################################################################################################################################*/
/*FUNCTION DECLARATIONS_________________________________________________________________________________________________________________________*/
/*##############################################################################################################################################*/



/*##############################################################################################################################################*/
/*GLOBALS_______________________________________________________________________________________________________________________________________*/
/*##############################################################################################################################################*/

char const * ssi_tags[] = {"TIME","SENSOR","BUTTON","RLED","BLED","GLED", "VALUE"};
char const ** tags =  ssi_tags;

/*##############################################################################################################################################*/
/*DEFINES_______________________________________________________________________________________________________________________________________*/
/*##############################################################################################################################################*/


/*##############################################################################################################################################*/
/*EXTERNS_______________________________________________________________________________________________________________________________________*/
/*##############################################################################################################################################*/

extern ADC_HandleTypeDef hADC1;

/*##############################################################################################################################################*/
/*TYPEDEFS/STRUCTS/ENUMS________________________________________________________________________________________________________________________*/
/*##############################################################################################################################################*/



/*##############################################################################################################################################*/
/*FUNCTIONS_____________________________________________________________________________________________________________________________________*/
/*##############################################################################################################################################*/

uint16_t SSI_SSIHandler(int iIndex, char *pcInsert, int iInsertLen)
{
	switch( iIndex )
	{
		case 0:
			sprintf(pcInsert, "%d SECONDS", (int)HAL_GetTick( )/1000 );
			return strlen(pcInsert);
			break;

		case 1:
			sprintf( pcInsert, "%0.1f&deg;C", ADC_getMCUTemp( ) );
			return strlen( pcInsert );
			break;	

		case 2:
			sprintf( pcInsert, "%s", BUTTON_getBtnState( ) );
			return strlen( pcInsert );
			break;

		case 3:
			if (isRedLedOn ==  GPIO_PIN_SET)
			{
				sprintf(pcInsert,"<input value=\"1\" name=\"led\" class=\"largerCheckbox\" type=\"checkbox\" checked>");
				return strlen(pcInsert);
			}
			else
			{
				sprintf(pcInsert,"<input value=\"1\" name=\"led\" class=\"largerCheckbox\"  type=\"checkbox\" unchecked>");
				return strlen(pcInsert);

			}
			break;

		case 4:
			if(isBlueLedOn == GPIO_PIN_SET)
			{
				sprintf(pcInsert,"<input value=\"2\" name=\"led\" class=\"largerCheckbox\" type=\"checkbox\" checked>");
				return strlen(pcInsert);
			}
			else
			{
				sprintf(pcInsert,"<input value=\"2\" name=\"led\" class=\"largerCheckbox\"  type=\"checkbox\" unchecked>");
				return strlen(pcInsert);

			}
			break;

		case 5:
			if(isGreenLedOn == GPIO_PIN_SET)
			{
				sprintf(pcInsert,"<input value=\"3\" name=\"led\" class=\"largerCheckbox\" type=\"checkbox\" checked>");
				return strlen(pcInsert);
			}
			else
			{
				sprintf(pcInsert,"<input value=\"3\" name=\"led\" class=\"largerCheckbox\"  type=\"checkbox\" unchecked>");
				return strlen(pcInsert);

			}
			break;
		
		case 6:
			sprintf( pcInsert, "%d", value );
			return strlen( pcInsert );
			break;
		
		default:
			break;	
	}
	return 0;
}
